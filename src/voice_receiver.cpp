#include "voice_receiver.h"

#include <cerrno>
#include <cstdio>
#include <cstdlib>
#include <cstring>

#include <esp_heap_caps.h>
#include <lwip/sockets.h>

namespace reply {
namespace {

constexpr const char* kClipName = "reply";

bool printableToken(const char* token) {
  const size_t length = std::strlen(token);
  if (length < 16 || length > Client::kMaxToken) return false;
  for (size_t i = 0; i < length; ++i) {
    const unsigned char value = static_cast<unsigned char>(token[i]);
    if (value < 0x21 || value > 0x7e) return false;
  }
  return true;
}

bool validTurnChar(char ch) {
  return (ch >= '0' && ch <= '9') || (ch >= 'a' && ch <= 'z') ||
         (ch >= 'A' && ch <= 'Z') || ch == '_' || ch == '-';
}

// Standard reflected CRC-32 (0xEDB88320), matching Python zlib.crc32.
uint32_t crcUpdate(uint32_t crc, const uint8_t* data, size_t length) {
  for (size_t i = 0; i < length; ++i) {
    crc ^= data[i];
    for (uint8_t bit = 0; bit < 8; ++bit) {
      crc = (crc & 1U) ? (crc >> 1) ^ 0xEDB88320UL : crc >> 1;
    }
  }
  return crc;
}

bool equalsIgnoreCase(const char* text, const char* prefix) {
  while (*prefix != '\0') {
    char a = *text++;
    char b = *prefix++;
    if (a >= 'A' && a <= 'Z') a = static_cast<char>(a - 'A' + 'a');
    if (b >= 'A' && b <= 'Z') b = static_cast<char>(b - 'A' + 'a');
    if (a != b) return false;
  }
  return true;
}

// Returns the value after "Name:" for the first matching header line. The
// response is small and generated by our own receiver, so a linear scan is
// simpler and cheaper than a general HTTP parser.
const char* headerValue(const char* header, const char* name) {
  const char* line = std::strstr(header, "\r\n");
  while (line != nullptr) {
    line += 2;
    if (equalsIgnoreCase(line, name)) {
      const char* colon = line + std::strlen(name);
      if (*colon == ':') {
        ++colon;
        while (*colon == ' ' || *colon == '\t') ++colon;
        return colon;
      }
    }
    line = std::strstr(line, "\r\n");
  }
  return nullptr;
}

bool parseUint(const char* text, uint32_t* value, int base = 10) {
  if (text == nullptr || *text == '\0') return false;
  char* end = nullptr;
  const unsigned long parsed = std::strtoul(text, &end, base);
  if (end == text) return false;
  *value = static_cast<uint32_t>(parsed);
  return true;
}

}  // namespace

Client::Client(audio::Engine& audio, const upload::Client& uploader)
    : audio_(audio), uploader_(uploader) {}

Client::~Client() {
  closeSocket();
  freePending();
  if (buffer_ != nullptr) {
    heap_caps_free(buffer_);
    buffer_ = nullptr;
  }
}

void Client::begin(const char* host, uint16_t port, const char* token) {
  host_[0] = '\0';
  token_[0] = '\0';
  port_ = 0;
  configured_ = false;
  address_ = IPAddress();

  if (host != nullptr) {
    std::snprintf(host_, sizeof(host_), "%s", host);
  }
  if (token != nullptr) {
    std::snprintf(token_, sizeof(token_), "%s", token);
  }
  port_ = port;
  address_.fromString(host_);
  const uint32_t rawAddress = static_cast<uint32_t>(address_);
  const bool hostValid = rawAddress != 0 && rawAddress != 0xFFFFFFFFUL;
  configured_ = hostValid && port_ != 0 && printableToken(token_);
  seenUploads_ = uploader_.successCount();

  // The token itself is never printed, only whether the config is complete.
  if (configured_) {
    Serial.printf(
        "VOICE_CONFIG configured=1 host=%s port=%u path=/reply/latest\n",
        host_, static_cast<unsigned>(port_));
  } else {
    Serial.println("VOICE_CONFIG configured=0");
  }
}

bool Client::active() const {
  return state_ == State::Connecting || state_ == State::Sending ||
         state_ == State::Header || state_ == State::Body ||
         state_ == State::Wait;
}

const char* Client::stateName() const {
  switch (state_) {
    case State::Idle:
      return "idle";
    case State::Connecting:
      return "connecting";
    case State::Sending:
      return "sending";
    case State::Header:
      return "header";
    case State::Body:
      return "body";
    case State::Wait:
      return "wait";
    case State::Done:
      return "done";
    case State::Failed:
      return "failed";
  }
  return "unknown";
}

bool Client::playing() const {
  return audio_.playing() && std::strcmp(audio_.clipName(), kClipName) == 0;
}

Client::StartResult Client::fetchLatest() {
  const char* turn = uploader_.lastTurn();
  if (turn != nullptr && *turn != '\0') {
    return start(turn, false, false);
  }
  return fetchNewest();
}

Client::StartResult Client::fetchNewest() {
  return start(nullptr, false, false);
}

Client::StartResult Client::start(const char* turn, bool polling,
                                  bool autoPlay) {
  if (active()) return StartResult::Busy;
  if (!configured_) return StartResult::NotConfigured;
  if (WiFi.status() != WL_CONNECTED) return StartResult::WifiDown;

  hasTurn_ = false;
  turn_[0] = '\0';
  if (turn != nullptr && *turn != '\0') {
    const size_t length = std::strlen(turn);
    if (length > kMaxTurn) return StartResult::NoTurn;
    for (size_t i = 0; i < length; ++i) {
      if (!validTurnChar(turn[i])) return StartResult::NoTurn;
    }
    std::memcpy(turn_, turn, length + 1);
    hasTurn_ = true;
  }

  polling_ = polling;
  autoPlay_ = autoPlay;
  requestLength_ = 0;
  requestSent_ = 0;
  headerLength_ = 0;
  header_[0] = '\0';
  expectedBytes_ = 0;
  receivedBytes_ = 0;
  headerFrames_ = 0;
  headerRate_ = 0;
  headerChannels_ = 0;
  headerCrc_ = 0;
  reason_[0] = '\0';
  freePending();
  if (!buildRequest()) {
    fail("header");
    return StartResult::Ok;
  }
  const uint32_t now = millis();
  client_.stop();
  state_ = State::Connecting;
  if (polling_) {
    pollDeadlineMs_ = now + kPollTimeoutMs;
  }
  Serial.printf("VOICE_FETCH_START turn=%s poll=%u\n",
                hasTurn_ ? turn_ : "-", polling_ ? 1U : 0U);
  return StartResult::Ok;
}

bool Client::buildRequest() {
  const int length = std::snprintf(
      request_, sizeof(request_),
      "GET /reply/latest%s%s HTTP/1.1\r\n"
      "Host: %s:%u\r\n"
      "X-Auth-Token: %s\r\n"
      "Connection: close\r\n\r\n",
      hasTurn_ ? "?turn=" : "", hasTurn_ ? turn_ : "", host_,
      static_cast<unsigned>(port_), token_);
  if (length <= 0 || static_cast<size_t>(length) >= sizeof(request_)) {
    requestLength_ = 0;
    return false;
  }
  requestLength_ = static_cast<size_t>(length);
  return true;
}

void Client::startAttempt(uint32_t now) {
  requestSent_ = 0;
  headerLength_ = 0;
  header_[0] = '\0';
  // Bounded blocking connect, same trade-off as the uploader: a missing
  // receiver delays one loop by at most one second.
  if (!client_.connect(address_, port_, kConnectTimeoutMs)) {
    fail("connect");
    return;
  }
  client_.setNoDelay(true);
  lastProgressMs_ = now;
  attemptDeadlineMs_ = now + kAttemptTimeoutMs;
  state_ = State::Sending;
}

void Client::pollAgain(uint32_t now) {
  closeSocket();
  freePending();
  if (static_cast<int32_t>(now - pollDeadlineMs_) >= 0) {
    fail("no_reply");
    return;
  }
  state_ = State::Wait;
  waitUntilMs_ = now + kPollIntervalMs;
}

void Client::freePending() {
  if (pending_ != nullptr) {
    heap_caps_free(pending_);
    pending_ = nullptr;
  }
  pendingBytes_ = 0;
}

void Client::closeSocket() {
  client_.stop();
}

void Client::fail(const char* reason) {
  closeSocket();
  freePending();
  std::snprintf(reason_, sizeof(reason_), "%s", reason);
  state_ = State::Failed;
  polling_ = false;
  autoPlay_ = false;
  ++failures_;
  Serial.printf("VOICE_FAILED reason=%s turn=%s\n", reason_,
                hasTurn_ ? turn_ : "-");
  Serial.printf("ERR voice_failed reason=%s\n", reason_);
}

void Client::cancel() {
  if (!active()) return;
  const bool wasPolling = polling_;
  closeSocket();
  freePending();
  polling_ = false;
  autoPlay_ = false;
  state_ = State::Idle;
  reason_[0] = '\0';
  Serial.printf("VOICE_CANCEL poll=%u\n", wasPolling ? 1U : 0U);
}

bool Client::play() {
  if (buffer_ == nullptr) return false;
  const bool wasPlaying = playing();
  if (!audio_.playClip(clip_)) return false;
  ++plays_;
  Serial.printf(
      "OK voice=playing id=%s bytes=%lu frames=%lu duration_ms=%lu "
      "restarted=%u\n",
      replyId_, static_cast<unsigned long>(replyBytes_),
      static_cast<unsigned long>(replyFrames_),
      static_cast<unsigned long>(replyDurationMs_), wasPlaying ? 1U : 0U);
  return true;
}

void Client::readHeader(uint32_t now) {
  while (client_.available() > 0 && headerLength_ < kMaxHeaderBytes) {
    const int value = client_.read();
    if (value < 0) break;
    header_[headerLength_++] = static_cast<char>(value);
    header_[headerLength_] = '\0';
    if (headerLength_ >= 4 &&
        std::strcmp(header_ + headerLength_ - 4, "\r\n\r\n") == 0) {
      parseHeader(now);
      return;
    }
  }
  if (headerLength_ >= kMaxHeaderBytes) {
    fail("header_large");
    return;
  }
  if (!client_.connected()) {
    fail(headerLength_ == 0 ? "closed" : "short_header");
    return;
  }
  if (static_cast<int32_t>(now - lastProgressMs_) >=
      static_cast<int32_t>(kStallTimeoutMs)) {
    fail("stall");
  }
}

void Client::parseHeader(uint32_t now) {
  if (std::strstr(header_, " 404 ") != nullptr) {
    closeSocket();
    if (polling_) {
      pollAgain(now);
    } else {
      fail("no_reply");
    }
    return;
  }
  if (std::strstr(header_, " 401 ") != nullptr) {
    fail("unauthorized");
    return;
  }
  if (std::strstr(header_, " 403 ") != nullptr) {
    fail("forbidden");
    return;
  }
  if (std::strstr(header_, " 200 ") == nullptr) {
    fail("rejected");
    return;
  }

  const char* lengthText = headerValue(header_, "Content-Length");
  const char* framesText = headerValue(header_, "X-Frames");
  const char* rateText = headerValue(header_, "X-Sample-Rate");
  const char* channelsText = headerValue(header_, "X-Channels");
  const char* crcText = headerValue(header_, "X-Crc32");
  const char* idText = headerValue(header_, "X-Reply-Id");
  if (!parseUint(lengthText, &expectedBytes_) ||
      !parseUint(framesText, &headerFrames_) ||
      !parseUint(rateText, &headerRate_) ||
      !parseUint(channelsText, &headerChannels_) ||
      !parseUint(crcText, &headerCrc_, 16) || idText == nullptr) {
    fail("bad_headers");
    return;
  }
  if (expectedBytes_ == 0 || expectedBytes_ > kMaxPcmBytes ||
      (expectedBytes_ % 2) != 0 || headerRate_ != kSampleRate ||
      headerChannels_ != 1 || headerFrames_ != expectedBytes_ / 2) {
    fail("bad_format");
    return;
  }

  // The reply ID from the header becomes this clip's id after the body and
  // CRC are accepted. It is not used to build a request, so a malformed value
  // is only truncated.
  size_t idLength = 0;
  while (idText[idLength] != '\0' && validTurnChar(idText[idLength]) &&
         idLength < kMaxTurn) {
    ++idLength;
  }
  std::memcpy(pendingId_, idText, idLength);
  pendingId_[idLength] = '\0';

  pending_ = static_cast<uint8_t*>(
      heap_caps_malloc(expectedBytes_, MALLOC_CAP_SPIRAM));
  if (pending_ == nullptr) {
    pending_ = static_cast<uint8_t*>(std::malloc(expectedBytes_));
  }
  if (pending_ == nullptr) {
    fail("no_memory");
    return;
  }
  pendingBytes_ = 0;
  receivedBytes_ = 0;
  lastProgressMs_ = now;
  state_ = State::Body;
}

void Client::readBody(uint32_t now) {
  if (client_.available() > 0 && receivedBytes_ < expectedBytes_) {
    size_t take = static_cast<size_t>(
        client_.available() > static_cast<int>(kReadChunkBytes)
            ? kReadChunkBytes
            : client_.available());
    if (take > expectedBytes_ - receivedBytes_) {
      take = expectedBytes_ - receivedBytes_;
    }
    const int read =
        client_.read(pending_ + receivedBytes_, take);
    if (read > 0) {
      receivedBytes_ += static_cast<uint32_t>(read);
      lastProgressMs_ = now;
      attemptDeadlineMs_ = now + kAttemptTimeoutMs;
    }
  }
  if (receivedBytes_ == expectedBytes_) {
    commit(now);
    return;
  }
  if (!client_.connected()) {
    fail(receivedBytes_ == 0 ? "closed" : "short_body");
    return;
  }
  if (static_cast<int32_t>(now - lastProgressMs_) >=
          static_cast<int32_t>(kStallTimeoutMs) ||
      static_cast<int32_t>(now - attemptDeadlineMs_) >= 0) {
    fail("stall");
  }
}

void Client::commit(uint32_t now) {
  (void)now;
  closeSocket();
  const uint32_t crc = crcUpdate(0xFFFFFFFFUL, pending_, receivedBytes_) ^
                       0xFFFFFFFFUL;
  if (crc != headerCrc_) {
    fail("crc");
    return;
  }
  if (playing()) audio_.stop();
  if (buffer_ != nullptr) {
    heap_caps_free(buffer_);
  }
  buffer_ = pending_;
  pending_ = nullptr;
  pendingBytes_ = 0;
  std::snprintf(replyId_, sizeof(replyId_), "%s", pendingId_);
  replyBytes_ = receivedBytes_;
  replyFrames_ = replyBytes_ / 2;
  replyCrc_ = crc;
  replyDurationMs_ =
      static_cast<uint32_t>((static_cast<uint64_t>(replyFrames_) * 1000ULL) /
                            kSampleRate);
  clip_ = {kClipName, buffer_, replyBytes_, kSampleRate, kVolumePercent};
  state_ = State::Done;
  polling_ = false;
  ++fetches_;
  Serial.printf(
      "VOICE_READY id=%s bytes=%lu frames=%lu duration_ms=%lu crc32=%08lx\n",
      replyId_, static_cast<unsigned long>(replyBytes_),
      static_cast<unsigned long>(replyFrames_),
      static_cast<unsigned long>(replyDurationMs_),
      static_cast<unsigned long>(replyCrc_));
  Serial.printf("OK voice=fetched id=%s bytes=%lu frames=%lu\n", replyId_,
                static_cast<unsigned long>(replyBytes_),
                static_cast<unsigned long>(replyFrames_));
  if (autoPlay_) {
    autoPlay_ = false;
    if (!play()) {
      Serial.println("ERR voice_play_failed");
    }
  }
}

void Client::update() {
  const uint32_t now = millis();

  // Auto mode only reacts to a completed upload, which itself requires an
  // explicit `mic upload`. The turn pins the request so an older reply can
  // never be mistaken for the answer to the new recording.
  if (auto_ && configured_ && uploader_.successCount() != seenUploads_) {
    if (active() && !polling_) {
      // Let the current download finish; the new upload is picked up next.
    } else if (uploader_.lastTurn()[0] == '\0') {
      seenUploads_ = uploader_.successCount();
      Serial.println("VOICE_AUTO_SKIP reason=no_turn");
    } else {
      if (active()) cancel();
      seenUploads_ = uploader_.successCount();
      if (start(uploader_.lastTurn(), true, true) != StartResult::Ok) {
        Serial.println("VOICE_AUTO_SKIP reason=start_failed");
      }
    }
  }

  switch (state_) {
    case State::Idle:
    case State::Done:
    case State::Failed:
      return;

    case State::Wait:
      if (static_cast<int32_t>(now - waitUntilMs_) >= 0) {
        state_ = State::Connecting;
      }
      return;

    case State::Connecting:
      startAttempt(now);
      return;

    case State::Sending: {
      if (!client_.connected()) {
        fail("closed");
        return;
      }
      if (static_cast<int32_t>(now - lastProgressMs_) >=
          static_cast<int32_t>(kStallTimeoutMs)) {
        fail("stall");
        return;
      }
      const int fd = client_.fd();
      if (fd < 0) {
        fail("socket");
        return;
      }
      const size_t take = requestLength_ - requestSent_;
      const int written = ::send(
          fd, reinterpret_cast<const uint8_t*>(request_) + requestSent_, take,
          MSG_DONTWAIT);
      if (written > 0) {
        requestSent_ += static_cast<size_t>(written);
        lastProgressMs_ = now;
        if (requestSent_ >= requestLength_) state_ = State::Header;
        return;
      }
      if (written < 0 && errno != EAGAIN && errno != EWOULDBLOCK) {
        fail("write");
      }
      return;
    }

    case State::Header:
      readHeader(now);
      return;

    case State::Body:
      readBody(now);
      return;
  }
}

void Client::printStatus() const {
  Serial.printf(
      "VOICE state=%s auto=%u configured=%u has_clip=%u id=%s bytes=%lu "
      "frames=%lu duration_ms=%lu crc32=%08lx playing=%u polling=%u "
      "fetches=%lu plays=%lu failures=%lu host=%s port=%u\n",
      stateName(), auto_ ? 1U : 0U, configured_ ? 1U : 0U,
      buffer_ != nullptr ? 1U : 0U, buffer_ != nullptr ? replyId_ : "-",
      static_cast<unsigned long>(replyBytes_),
      static_cast<unsigned long>(replyFrames_),
      static_cast<unsigned long>(replyDurationMs_),
      static_cast<unsigned long>(replyCrc_), playing() ? 1U : 0U,
      polling_ ? 1U : 0U, static_cast<unsigned long>(fetches_),
      static_cast<unsigned long>(plays_),
      static_cast<unsigned long>(failures_), host_,
      static_cast<unsigned>(port_));
}

}  // namespace reply
